## ESP-32/main/Kconfig.projbuild
```kconfig
menu "Loop config"
    config NUM_NEOPIXEL_IN_LOOP
        int  "Number of Neopixels in loop"
        default 120
        help
            Number of Neopixels in visual loop.
    
    config WIFI_SSID
        string "WiFi SSID"
        default "loop_gw"
        help
            SSID of local back channel.
     

    config WIFI_PASSWORD
        string "WiFi Password"
        default "12341234"
        help
            WiFi password (WPA or WPA2) for the networks.
endmenu
```

## esp32_metric/components/models/Kconfig
```kconfig
menu "Model selection"

    choice MODEL_VERSION
        prompt "Select Model Version"
        default MODEL_VERSION_1_0
        help
            Select the model to use for the project.

    config MODEL_VERSION_1_0
        bool "1.0"
    config MODEL_VERSION_2_0
        bool "2.0"

    endchoice

endmenu
```
